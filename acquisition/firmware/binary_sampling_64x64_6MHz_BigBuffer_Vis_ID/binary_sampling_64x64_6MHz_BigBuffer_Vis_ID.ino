#include <SPI.h>
#include <MCP41HVX1.h>

// Board ID (set differently on each board: 1–4)
static const uint16_t BOARD_ID = 4;

// Constants
static const int ROWS = 64;
static const int COLS = 64;
static const int N = ROWS * COLS;

// Configurable parameters, set by the host at start-up (record_runway.py)
static const int MAX_M = 2048;  // Maximum possible M
static int M = 500;             // Number of samples to take per frame
static int thr = 200;           // Threshold for neighbor sampling
static int digipot = 0;         // Digipot setting

// Pin definitions
#define ANALOG0 20
#define ANALOG1 21

// Shift register pins
#define MR 16
#define SHCP 15
#define STCP 14
#define OE 41
#define DS1 40  // Input to shift registers controlling rows 0-31
#define DS2 39  // Input to shift registers controlling rows 32-63
#define Q7S1 8  // Output from last shift register in chain 1
#define Q7S2 7  // Output from last shift register in chain 2

// Mux pins
#define MUX0 37
#define MUX1 36
#define MUX2 35
#define MUX3 34
#define MUX4 33

// Mux enables
#define EN1 10  // Enable for mux handling columns 0-31
#define EN2 9   // Enable for mux handling columns 32-63

// SPI CS pins
#define CS1 30  // Potentiometer 1
#define CS2 29  // Potentiometer 2
#define CS3 31  // SPI ADC1 (columns 0-31)
#define CS4 32  // SPI ADC2 (columns 32-63)

// Potentiometer pins
#define SHDN1 27
#define WLAT1 28
#define SHDN2 25
#define WLAT2 26

// LED pin
#define LEDpin 38

// Double buffering for continuous streaming
struct ThresholdPixel {
  uint16_t index;  // Storage index
  uint16_t value;  // Sensor value
};

static const int BUFFER_SIZE = MAX_M + 1; // Adjust based on expected touch density
volatile ThresholdPixel buffer1[BUFFER_SIZE];
volatile ThresholdPixel buffer2[BUFFER_SIZE];
volatile ThresholdPixel* writeBuffer = buffer1;
volatile ThresholdPixel* sendBuffer = buffer2;
volatile uint16_t writeIndex = 0;
volatile bool bufferReady = false;
volatile uint32_t frameCounter = 0;
volatile uint32_t frameTime = 0;

// Sampling arrays - using fixed size with MAX_M
int msrValArr[MAX_M];
int msrPosArr[MAX_M];
bool isSampled[N];
int idx = 0;

// Neighbor sampling pattern
int colOrd[3] = {0, -1, 1};

// Current row tracking for optimization
int currentRow = -1;

// Priority center tracking
struct CenterPoint {
  int row, col;
};

static const int MAX_PRIORITY_CENTERS = 50;
CenterPoint priorityCenters[MAX_PRIORITY_CENTERS];
int numPriorityCenters = 0;

// Spatial offset for shifting sampling pattern
int spatialOffsetX = 0;
int spatialOffsetY = 0;

int lastMeasuredRow = -1;
int lastMeasuredCol = -1;

// Mux lookup table for 32 columns
int muxtable[32][5] = {
  {0, 0, 0, 0, 0}, {1, 0, 0, 0, 0}, {0, 1, 0, 0, 0}, {1, 1, 0, 0, 0},
  {0, 0, 1, 0, 0}, {1, 0, 1, 0, 0}, {0, 1, 1, 0, 0}, {1, 1, 1, 0, 0},
  {0, 0, 0, 1, 0}, {1, 0, 0, 1, 0}, {0, 1, 0, 1, 0}, {1, 1, 0, 1, 0},
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  {0, 0, 1, 1, 1}, {1, 0, 1, 1, 1}, {0, 1, 1, 1, 1}, {1, 1, 1, 1, 1}
};

// SPI settings and potentiometer objects
SPISettings settings(6E6, MSBFIRST, SPI_MODE0);  // 6 MHz SPI clock
MCP41HVX1 Digipot1(CS1, SHDN1, WLAT1);
MCP41HVX1 Digipot2(CS2, SHDN2, WLAT2);

// Preloaded sampling pattern arrays
int ctrMsrRows[N] = {31, 15, 15, 47, 47, 7, 7, 7, 7, 23, 23, 23, 23,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 63, 63};
int ctrMsrCols[N] = {31, 15, 47, 15, 47, 7, 23, 39, 55, 7, 23, 39, 55,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 62, 63};

// Fast buffer operations
inline void addThresholdPixel(uint16_t index, uint16_t value) {
  if (writeIndex < BUFFER_SIZE - 1) {  // Leave space for frame marker
    writeBuffer[writeIndex].index = index;
    writeBuffer[writeIndex].value = value;
    writeIndex++;
  }
}

inline void finishFrame(uint32_t timing) {
  // Add frame end marker
  if (writeIndex < BUFFER_SIZE) {
    writeBuffer[writeIndex].index = 0xFFFF;  // Frame end marker
    writeBuffer[writeIndex].value = timing & 0xFFFF;  // Lower 16 bits of timing
    writeIndex++;
  }

  // Mark buffer ready for sending
  bufferReady = true;
  frameCounter++;
  frameTime = timing;
}

void swapBuffers() {
  noInterrupts();
  if (bufferReady) {
    // Swap buffer pointers
    volatile ThresholdPixel* temp = writeBuffer;
    writeBuffer = sendBuffer;
    sendBuffer = temp;

    uint16_t sendCount = writeIndex;
    writeIndex = 0;
    bufferReady = false;

    interrupts();

    // Send data immediately (non-blocking)
    sendBufferData(sendCount);
  } else {
    interrupts();
  }
}

void sendBufferData(uint16_t count) {
  // Send frame header
  uint32_t header = 0xDEADBEEF;  // Sync marker
  uint16_t id     = BOARD_ID;    // Board ID: 1–4

  Serial.write((uint8_t*)&header, 4);       // 0xDEADBEEF
  Serial.write((uint8_t*)&id, 2);           // board ID
  Serial.write((uint8_t*)&count, 2);        // number of ThresholdPixel entries
  Serial.write((uint8_t*)&frameCounter, 2); // lower 16 bits of frame counter

  // Send all pixels in buffer
  Serial.write((uint8_t*)sendBuffer, count * 4);
}

// Convert (row, col) to linear index for isSampled array
inline int pos2D(int row, int col) {
  return row * COLS + col;
}

// Convert (row, col) to storage index
int valIndex(int row, int col) {
  if (col < 32) {
    return row * 32 + col;
  } else {
    return row * 32 + (col - 32) + 2048;
  }
}

void initializeShiftRegisters() {
  digitalWriteFast(MR, LOW);
  digitalWriteFast(MR, HIGH);
  currentRow = -1;
  lastMeasuredRow = -1;  // Reset state tracking
  lastMeasuredCol = -1;  // Reset state tracking
}

void setRowOptimized(int targetRow) {
  if (targetRow == currentRow) return;

  if (currentRow == -1) {
    digitalWriteFast(STCP, LOW);
    digitalWriteFast(DS1, HIGH);
    digitalWriteFast(DS2, LOW);
    digitalWriteFast(SHCP, HIGH);
    digitalWriteFast(SHCP, LOW);
    digitalWriteFast(STCP, HIGH);
    currentRow = 0;

    while (currentRow < targetRow) {
      advanceToNextRow(currentRow + 1);
    }
  } else if (targetRow > currentRow) {
    while (currentRow < targetRow) {
      advanceToNextRow(currentRow + 1);
    }
  } else {
    int forwardDistance = (64 - currentRow) + targetRow;
    int resetDistance = targetRow + 1;

    if (resetDistance < forwardDistance) {
      initializeShiftRegisters();
      setRowOptimized(targetRow);
    } else {
      while (currentRow != targetRow) {
        advanceToNextRow((currentRow + 1) % 64);
      }
    }
  }
}

void advanceToNextRow(int row) {
  digitalWriteFast(STCP, LOW);

  if (row < 32) {
    digitalWriteFast(DS1, LOW);
    digitalWriteFast(DS2, LOW);
  } else if (row == 32) {
    digitalWriteFast(DS1, LOW);
    digitalWriteFast(DS2, HIGH);
  } else {
    digitalWriteFast(DS1, LOW);
    digitalWriteFast(DS2, LOW);
  }

  digitalWriteFast(SHCP, HIGH);
  digitalWriteFast(SHCP, LOW);
  digitalWriteFast(STCP, HIGH);

  currentRow = row;
}

void setColumn(int col) {
  int mux_col = col % 32;

  digitalWriteFast(MUX4, muxtable[mux_col][4]);
  digitalWriteFast(MUX3, muxtable[mux_col][3]);
  digitalWriteFast(MUX2, muxtable[mux_col][2]);
  digitalWriteFast(MUX1, muxtable[mux_col][1]);
  digitalWriteFast(MUX0, muxtable[mux_col][0]);

  if (col < 32) {
    digitalWriteFast(EN1, LOW);
    digitalWriteFast(EN2, HIGH);
  } else {
    digitalWriteFast(EN1, HIGH);
    digitalWriteFast(EN2, LOW);
  }
}

int measureSensor(int row, int col) {
  // Only change row if different from last measurement
  if (row != lastMeasuredRow) {
    setRowOptimized(row);
    lastMeasuredRow = row;
  }

  // Only change column if different from last measurement
  if (col != lastMeasuredCol) {
    setColumn(col);
    lastMeasuredCol = col;
  }

  delayNanoseconds(1500);

  int reading = 0;

  if (col < 32) {
    digitalWriteFast(CS3, LOW);
    SPI.beginTransaction(settings);
    reading = SPI.transfer16(0x0000);
    SPI.endTransaction();
    digitalWriteFast(CS3, HIGH);
  } else {
    digitalWriteFast(CS4, LOW);
    SPI.beginTransaction(settings);
    reading = SPI.transfer16(0x0000);
    SPI.endTransaction();
    digitalWriteFast(CS4, HIGH);
  }

  return reading;
}

// Check for new configuration (non-blocking)
void checkForNewConfig() {
  if (Serial.available() >= 6) {  // At least "100 150 50" = 6+ chars
    // Read new configuration
    int newM = Serial.parseInt();
    int newThr = Serial.parseInt();
    int newDigipot = Serial.parseInt();

    // Update if valid
    if (newM > 0 && newM <= MAX_M) {
      M = newM;
    }
    if (newThr >= 0) {
      thr = newThr;
    }
    if (newDigipot >= 0) {
      digipot = newDigipot;
      Digipot1.WiperSetPosition(digipot);
      Digipot2.WiperSetPosition(digipot);
    }

    // Send OK as a special frame marker instead of text
    if (writeIndex < BUFFER_SIZE - 1) {
      writeBuffer[writeIndex].index = 0xFFFE;  // Special "CONFIG OK" marker
      writeBuffer[writeIndex].value = 0x4F4B;  // "OK" in hex
      writeIndex++;
    }
  }
}

void addPriorityCenter(int centerX, int centerY) {
  // Check if already in list
  for (int i = 0; i < numPriorityCenters; i++) {
    if (priorityCenters[i].row == centerX && priorityCenters[i].col == centerY) {
      return; // Already tracked
    }
  }

  // Add new center if space available
  if (numPriorityCenters < MAX_PRIORITY_CENTERS) {
    priorityCenters[numPriorityCenters].row = centerX;
    priorityCenters[numPriorityCenters].col = centerY;
    numPriorityCenters++;
  }
}

void neighborSampling(int centerX, int centerY, bool isOriginalTrigger = false) {
  if (isOriginalTrigger) {
    addPriorityCenter(centerX, centerY);
  }

  for (int jj = 0; jj < 3; jj++) {
    int newCol = centerY + colOrd[jj];
    if (newCol < 0 || newCol >= COLS) continue;

    for (int r = centerX - 1; r <= centerX + 1; r++) {
      if (r < 0 || r >= ROWS) continue;
      if (idx >= M) return;

      int checkPos = pos2D(r, newCol);
      if (isSampled[checkPos]) continue;

      int val = measureSensor(r, newCol);
      isSampled[checkPos] = true;

      int storageIdx = valIndex(r, newCol);
      msrPosArr[idx] = storageIdx;
      msrValArr[idx] = val;
      idx++;

      // Add to stream buffer (every sampled taxel is sent)
      addThresholdPixel(storageIdx, val);

      if (idx >= M) return;

      if (val > thr) {
        neighborSampling(r, newCol, false);
        if (idx >= M) return;
      }
    }
  }
}

void binarySampling() {
  unsigned long timer1 = micros();

  // Reset sampling state
  idx = 0;
  memset(isSampled, false, N * sizeof(bool));

  initializeShiftRegisters();

  // Store current priority centers before clearing
  int currentPriorityCenters = numPriorityCenters;
  CenterPoint framePriorities[MAX_PRIORITY_CENTERS];
  for (int i = 0; i < currentPriorityCenters; i++) {
    framePriorities[i] = priorityCenters[i];
  }

  numPriorityCenters = 0;

  // MODE 1: Sample priority centers first
  for (int p = 0; p < currentPriorityCenters && idx < M; p++) {
    int r = framePriorities[p].row;
    int c = framePriorities[p].col;

    int checkPos = pos2D(r, c);
    if (isSampled[checkPos]) continue;

    int val = measureSensor(r, c);
    isSampled[checkPos] = true;

    int storageIdx = valIndex(r, c);
    msrPosArr[idx] = storageIdx;
    msrValArr[idx] = val;
    idx++;

    // Add to stream buffer (every sampled taxel is sent)
    addThresholdPixel(storageIdx, val);

    if (idx >= M) break;

    if (val > thr) {
      neighborSampling(r, c, true);
      if (idx >= M) break;
    }
  }

  // MODE 2: Sample shifted pattern
  for (int i = 0; i < N && idx < M; i++) {
    int baseR = ctrMsrRows[i];
    int baseC = ctrMsrCols[i];

    int r = (baseR + spatialOffsetX) % ROWS;
    int c = (baseC + spatialOffsetY) % COLS;

    int checkPos = pos2D(r, c);
    if (isSampled[checkPos]) continue;

    int val = measureSensor(r, c);
    isSampled[checkPos] = true;

    int storageIdx = valIndex(r, c);
    msrPosArr[idx] = storageIdx;
    msrValArr[idx] = val;
    idx++;

    // Add to stream buffer (every sampled taxel is sent)
    addThresholdPixel(storageIdx, val);

    if (idx >= M) break;

    if (val > thr) {
      neighborSampling(r, c, true);
      if (idx >= M) break;
    }
  }

  // Advance spatial offset
  spatialOffsetY++;
  if (spatialOffsetY >= COLS) {
    spatialOffsetY = 0;
    spatialOffsetX++;
    if (spatialOffsetX >= ROWS) {
      spatialOffsetX = 0;
    }
  }

  timer1 = micros() - timer1;
  finishFrame(timer1);
}

void setup() {
  Serial.begin(0);  // Full USB speed

  pinMode(STCP, OUTPUT);
  pinMode(DS1, OUTPUT);
  pinMode(DS2, OUTPUT);
  pinMode(SHCP, OUTPUT);
  pinMode(OE, OUTPUT);
  pinMode(MR, OUTPUT);

  initializeShiftRegisters();
  digitalWriteFast(OE, LOW);

  pinMode(MUX0, OUTPUT);
  pinMode(MUX1, OUTPUT);
  pinMode(MUX2, OUTPUT);
  pinMode(MUX3, OUTPUT);
  pinMode(MUX4, OUTPUT);

  pinMode(EN1, OUTPUT);
  pinMode(EN2, OUTPUT);

  pinMode(CS1, OUTPUT);
  pinMode(CS2, OUTPUT);
  pinMode(CS3, OUTPUT);
  pinMode(CS4, OUTPUT);

  pinMode(LEDpin, OUTPUT);

  digitalWriteFast(CS1, HIGH);
  digitalWriteFast(CS2, HIGH);
  digitalWriteFast(CS3, HIGH);
  digitalWriteFast(CS4, HIGH);

  SPI.begin();

  digitalWriteFast(EN1, HIGH);
  digitalWriteFast(EN2, HIGH);

  delay(1000);  // Brief delay for serial connection

  // Just wait for configuration data
  while (!Serial.available()) {
    delay(10);
  }

  // Read three numbers: M, threshold, digipot
  M = Serial.parseInt();
  thr = Serial.parseInt();
  digipot = Serial.parseInt();

  // Clamp M to valid range
  if (M > MAX_M) M = MAX_M;
  if (M < 1) M = 1;

  // Set digipots
  Digipot1.WiperSetPosition(digipot);
  Digipot2.WiperSetPosition(digipot);

  Serial.println("OK");

  digitalWrite(LEDpin, HIGH); // turn on LED after config

  delay(100);
}

FASTRUN void loop() {
  // Check for new config (non-blocking)
  checkForNewConfig();

  // Perform sampling (never blocks on Serial)
  binarySampling();

  // Handle buffer swapping and sending (non-blocking)
  swapBuffers();
}
